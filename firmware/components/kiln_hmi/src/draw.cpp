/* SPDX-FileCopyrightText: 2026 Bitcrush Testing
 * SPDX-License-Identifier: GPL-3.0-or-later
 *
 * Framebuffer primitives and the 5x7 font (HR-04).
 *
 * Every routine here clips rather than asserting.  A screen that draws one
 * pixel off the edge should lose that pixel, not take down a kiln: this code
 * runs on the same MCU as the safety supervisor, and FR-HMI-14's position is
 * that the display is the least important thing in the box.
 *
 * Lower case reuses the upper-case glyphs.  At five pixels wide a distinct
 * lower-case set is less legible rather than more, and FR-HMI-03 cares about
 * being readable at two metres.
 */
#include <string.h>

#include "kiln_hmi/draw.h"

/* 95 printable ASCII glyphs, five columns each, bit 0 at the top. */
static const uint8_t k_font5x7[95][5] = {
    { 0x00, 0x00, 0x00, 0x00, 0x00 }, /* ' ' */
    { 0x00, 0x00, 0x2F, 0x00, 0x00 }, /* '!' */
    { 0x00, 0x03, 0x00, 0x03, 0x00 }, /* '"' */
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    { 0x06, 0x01, 0x02, 0x04, 0x03 }, /* '~' */};

#define FONT_W   5
#define FONT_ADV 6   /* one blank column between glyphs */
#define FONT_H   7

void kiln_fb_clear(kiln_fb_t *fb)
{
    if (fb != NULL) {
        memset(fb->px, 0, sizeof(fb->px));
    }
}

void kiln_fb_pixel(kiln_fb_t *fb, int x, int y, bool on)
{
    if ((fb == NULL) || x < 0 || y < 0 ||
        x >= KILN_DISPLAY_W || y >= KILN_DISPLAY_H) {
        return;                      /* clip, never fault */
    }
    /* x and y are clipped above, so this cannot overflow; the arithmetic is
     * done in size_t rather than cast afterwards so that is evident. */
    const size_t  idx  = ((size_t)y / 8u) * (size_t)KILN_DISPLAY_W + (size_t)x;
    const uint8_t mask = (uint8_t)(1u << (y % 8));
    if (on) { fb->px[idx] |= mask; }
    else    { fb->px[idx] = (uint8_t)(fb->px[idx] & (uint8_t)~mask); }
}

void kiln_fb_hline(kiln_fb_t *fb, int x, int y, int w, bool on)
{
    for (int i = 0; i < w; i++) { kiln_fb_pixel(fb, x + i, y, on); }
}

void kiln_fb_vline(kiln_fb_t *fb, int x, int y, int h, bool on)
{
    for (int i = 0; i < h; i++) { kiln_fb_pixel(fb, x, y + i, on); }
}

void kiln_fb_rect(kiln_fb_t *fb, int x, int y, int w, int h, bool on)
{
    if (w <= 0 || h <= 0) { return; }
    kiln_fb_hline(fb, x, y, w, on);
    kiln_fb_hline(fb, x, y + h - 1, w, on);
    kiln_fb_vline(fb, x, y, h, on);
    kiln_fb_vline(fb, x + w - 1, y, h, on);
}

void kiln_fb_fill(kiln_fb_t *fb, int x, int y, int w, int h, bool on)
{
    for (int j = 0; j < h; j++) {
        kiln_fb_hline(fb, x, y + j, w, on);
    }
}

static void glyph(kiln_fb_t *fb, int x, int y, char c, int scale, bool on)
{
    if (c < 32 || c > 126) { c = '?'; }
    const uint8_t *g = k_font5x7[(unsigned char)c - 32];
    for (int col = 0; col < FONT_W; col++) {
        for (int row = 0; row < FONT_H; row++) {
            if ((g[col] & (1u << row)) == 0u) { continue; }
            if (scale == 1) {
                kiln_fb_pixel(fb, x + col, y + row, on);
            } else {
                kiln_fb_fill(fb, x + col * scale, y + row * scale, scale, scale, on);
            }
        }
    }
}

void kiln_fb_text(kiln_fb_t *fb, int x, int y, const char *s, int scale, bool on)
{
    if ((fb == NULL) || (s == NULL) || scale < 1) { return; }
    int cx = x;
    for (; *s != '\0'; s++) {
        glyph(fb, cx, y, *s, scale, on);
        cx += FONT_ADV * scale;
        if (cx >= KILN_DISPLAY_W) { break; }   /* nothing further can be seen */
    }
}

int kiln_fb_text_width(const char *s, int scale)
{
    if ((s == NULL) || scale < 1) { return 0; }
    const int n = (int)strlen(s);
    /* The trailing advance column is not part of the ink. */
    return (n > 0) ? (n * FONT_ADV * scale - scale) : 0;
}

void kiln_fb_text_right(kiln_fb_t *fb, int right_x, int y, const char *s, int scale)
{
    kiln_fb_text(fb, right_x - kiln_fb_text_width(s, scale), y, s, scale, true);
}

void kiln_fb_text_inv(kiln_fb_t *fb, int x, int y, const char *s, int scale)
{
    /* A filled bar with the glyphs knocked out of it: the selected row of a
     * menu, which has to be obvious at a glance across a workshop. */
    const int w = kiln_fb_text_width(s, scale) + 2 * scale;
    const int h = FONT_H * scale + 2;
    kiln_fb_fill(fb, x - scale, y - 1, w, h, true);
    kiln_fb_text(fb, x, y, s, scale, false);
}

void kiln_fb_progress(kiln_fb_t *fb, int x, int y, int w, int h, uint8_t percent)
{
    if (w < 2 || h < 2) { return; }
    if (percent > 100u) { percent = 100u; }
    kiln_fb_rect(fb, x, y, w, h, true);
    const int inner = w - 2;
    const int fill  = (inner * (int)percent) / 100;
    if (fill > 0) {
        kiln_fb_fill(fb, x + 1, y + 1, fill, h - 2, true);
    }
}
