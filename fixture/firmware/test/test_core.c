/* Host tests for the generated fixture firmware: no board, no SDK, no USB.
 *
 * The protocol layer and the channel tables are the two things that can be wrong in a way the
 * bench will not tell you about clearly -- a mis-scaled ADC reading or a guard that does not
 * hold looks like a hardware fault. So they are tested here, against the mock HAL, using the
 * tables this very config generated.
 *
 * Most assertions are written against whatever channels exist rather than against named ones,
 * so this file stays valid for any config pinside is pointed at.
 *
 * Generated by pinside. Regenerating overwrites this file.
 */

#include <stdio.h>
#include <string.h>

#include "fixture_config.h"
#include "fixture_core.h"
#include "fixture_hal.h"
#include "mock_hal.h"

static int failures;
static int checks;
static const char* current;

static void check(bool ok, const char* what) {
  checks++;
  if (!ok) {
    failures++;
    printf("  FAIL %s: %s\n", current, what);
    printf("       last line: %s\n", mock_last_line());
  }
}

static void begin(const char* name) {
  current = name;
  mock_reset();
  fx_core_init();
  mock.out_len = 0; /* drop the ready notification; tests assert on what follows */
  mock.out[0] = '\0';
}

static void send(const char* line) {
  fx_core_feed(line, strlen(line));
  fx_core_feed("\n", 1);
}

static bool last_has(const char* needle) { return strstr(mock_last_line(), needle) != NULL; }

/* ------------------------------------------------------------------ tests */

static void test_ready_notification(void) {
  current = "ready notification";
  mock_reset();
  fx_core_init();
  check(mock_out_contains("\"method\":\"fixture.ready\""), "announces itself on init");
  check(mock_out_contains(fx_fixture_name), "names the fixture");
  check(mock_out_contains(fx_config_hash), "carries the config hash");
  check(mock.out[mock.out_len - 1] == '\n', "notification is newline terminated");
}

static void test_info(void) {
  begin("fixture.info");
  send("{\"jsonrpc\":\"2.0\",\"id\":1,\"method\":\"fixture.info\"}");
  check(last_has("\"id\":1"), "echoes a numeric id");
  check(last_has(fx_target_mcu), "reports the target");
  char expect[64];
  snprintf(expect, sizeof(expect), "\"gpio\":%d", (int)fx_gpio_count);
  check(last_has(expect), "reports the gpio count");
  snprintf(expect, sizeof(expect), "\"uart\":%d", (int)fx_uart_count);
  check(last_has(expect), "reports the uart count");
}

static void test_channels_lists_everything(void) {
  begin("fixture.channels");
  send("{\"jsonrpc\":\"2.0\",\"id\":\"abc\",\"method\":\"fixture.channels\"}");
  check(last_has("\"id\":\"abc\""), "echoes a string id");
  for (size_t i = 0; i < fx_gpio_count; i++) check(last_has(fx_gpio[i].name), "lists each gpio");
  for (size_t i = 0; i < fx_adc_count; i++) check(last_has(fx_adc[i].name), "lists each adc");
  for (size_t i = 0; i < fx_uart_count; i++) check(last_has(fx_uart[i].name), "lists each uart");
  for (size_t i = 0; i < fx_i2c_count; i++) check(last_has(fx_i2c[i].name), "lists each i2c");
  for (size_t i = 0; i < fx_spi_count; i++) check(last_has(fx_spi[i].name), "lists each spi");
}

static void test_protocol_errors(void) {
  begin("protocol errors");
  send("{\"jsonrpc\":\"2.0\",\"id\":2,\"method\":\"nope.nothing\"}");
  check(last_has("-32601"), "unknown method is method-not-found");

  send("{\"jsonrpc\":\"2.0\",\"id\":3}");
  check(last_has("-32600"), "a request with no method is invalid");

  send("not json at all");
  check(last_has("-32600"), "garbage is invalid, not a crash");

  send("{\"jsonrpc\":\"2.0\",\"method\":\"fixture.info\"}");
  check(last_has("\"id\":null"), "a request without an id answers with a null id");
}

static void test_long_line_is_rejected_and_recovered(void) {
  begin("oversized line");
  for (int i = 0; i < FX_LINE_MAX + 64; i++) fx_core_feed_byte('x');
  fx_core_feed_byte('\n');
  check(last_has("-32600"), "an over-long line is refused");
  send("{\"jsonrpc\":\"2.0\",\"id\":9,\"method\":\"fixture.info\"}");
  check(last_has("\"id\":9"), "and the next request still works");
}

static void test_gpio(void) {
  if (fx_gpio_count == 0) return;
  begin("gpio");

  send("{\"jsonrpc\":\"2.0\",\"id\":1,\"method\":\"gpio.read\",\"params\":{\"channel\":\"nope\"}}");
  check(last_has("-32001"), "unknown gpio channel is rejected");

  send("{\"jsonrpc\":\"2.0\",\"id\":1,\"method\":\"gpio.read\"}");
  check(last_has("-32602"), "a missing channel parameter is rejected");

  char req[256];
  snprintf(
      req, sizeof(req),
      "{\"jsonrpc\":\"2.0\",\"id\":1,\"method\":\"gpio.read\",\"params\":{\"channel\":\"%s\"}}",
      fx_gpio[0].name);
  send(req);
  check(last_has("\"level\":"), "read reports a level");
  check(last_has("\"asserted\":"), "read reports assertion, not just the raw level");

  for (size_t i = 0; i < fx_gpio_count; i++) {
    const fx_gpio_desc* g = &fx_gpio[i];
    snprintf(req, sizeof(req),
             "{\"jsonrpc\":\"2.0\",\"id\":1,\"method\":\"gpio.write\","
             "\"params\":{\"channel\":\"%s\",\"assert\":true}}",
             g->name);
    send(req);
    if (g->direction == FX_DIR_INPUT) {
      check(last_has("-32002"), "an input channel refuses writes");
      continue;
    }
    check(last_has("\"asserted\":true"), "asserting a writable channel reports it asserted");
    if (g->active_low)
      check(mock.level[g->pin] == false, "an active-low channel asserts by driving low");
    else
      check(mock.level[g->pin] == true, "an active-high channel asserts by driving high");

    snprintf(req, sizeof(req),
             "{\"jsonrpc\":\"2.0\",\"id\":1,\"method\":\"gpio.write\","
             "\"params\":{\"channel\":\"%s\",\"assert\":false}}",
             g->name);
    send(req);
    if (g->direction == FX_DIR_OPEN_DRAIN)
      check(mock.floating[g->pin], "releasing an open-drain channel lets the line float");
  }
}

static void test_adc_scaling(void) {
  if (fx_adc_count == 0) return;
  begin("adc");
  const fx_adc_desc* a = &fx_adc[0];
  /* Half of full scale is 1650 mV at the pin, times the divider ratio. */
  mock.adc[a->adc] = 2047;
  long expect = (long)((uint64_t)(2047u * 3300u / 4095u) * a->divider_milli / 1000u);
  char req[256];
  snprintf(req, sizeof(req),
           "{\"jsonrpc\":\"2.0\",\"id\":1,\"method\":\"adc.read\",\"params\":{\"channel\":\"%s\"}}",
           a->name);
  send(req);
  char expect_str[64];
  snprintf(expect_str, sizeof(expect_str), "\"millivolts\":%ld", expect);
  check(last_has(expect_str), "the divider ratio is applied to the reading");
  check(last_has("\"raw\":2047"), "the raw count is reported alongside");

  send("{\"jsonrpc\":\"2.0\",\"id\":1,\"method\":\"adc.snapshot\"}");
  for (size_t i = 0; i < fx_adc_count; i++) check(last_has(fx_adc[i].name), "snapshot covers all");
}

static void test_uart(void) {
  if (fx_uart_count == 0) return;
  begin("uart");
  const fx_uart_desc* u = &fx_uart[0];
  char req[512];

  snprintf(req, sizeof(req),
           "{\"jsonrpc\":\"2.0\",\"id\":1,\"method\":\"uart.write\","
           "\"params\":{\"channel\":\"%s\",\"hex\":\"48656c6c6f\"}}",
           u->name);
  send(req);
  if (u->guard >= 0 && !fx_gpio[u->guard].initial_asserted) {
    check(last_has("-32003"), "a guarded bus refuses to transmit until the guard is asserted");
  } else {
    check(last_has("\"written\":5"), "writes the decoded payload");
    check(mock.uart_tx_len[u->index] == 5, "the bytes reach the peripheral");
    check(memcmp(mock.uart_tx[u->index], "Hello", 5) == 0, "and they are the right bytes");
  }

  snprintf(req, sizeof(req),
           "{\"jsonrpc\":\"2.0\",\"id\":1,\"method\":\"uart.write\","
           "\"params\":{\"channel\":\"%s\",\"hex\":\"abc\"}}",
           u->name);
  send(req);
  check(last_has("-32602"), "odd-length hex is rejected");

  memcpy(mock.uart_rx[u->index], "OK", 2);
  mock.uart_rx_len[u->index] = 2;
  snprintf(req, sizeof(req),
           "{\"jsonrpc\":\"2.0\",\"id\":1,\"method\":\"uart.read\","
           "\"params\":{\"channel\":\"%s\",\"max\":16}}",
           u->name);
  send(req);
  check(last_has("\"hex\":\"4f4b\""), "reads come back as hex");
  check(last_has("\"length\":2"), "with a length");

  snprintf(req, sizeof(req),
           "{\"jsonrpc\":\"2.0\",\"id\":1,\"method\":\"uart.configure\","
           "\"params\":{\"channel\":\"%s\",\"baud\":9600}}",
           u->name);
  send(req);
  check(mock.uart_baud[u->index] == 9600, "the baud rate can be changed at runtime");
}

static void test_uart_streaming(void) {
  const fx_uart_desc* streamed = NULL;
  for (size_t i = 0; i < fx_uart_count; i++)
    if (fx_uart[i].stream) streamed = &fx_uart[i];
  if (!streamed) return;

  begin("uart streaming");
  memcpy(mock.uart_rx[streamed->index], "log", 3);
  mock.uart_rx_len[streamed->index] = 3;
  mock.millis = 1234;
  fx_core_poll();
  check(last_has("\"method\":\"uart.data\""), "streamed traffic is pushed unasked");
  check(last_has("\"hex\":\"6c6f67\""), "with the received bytes");
  check(last_has("\"t_ms\":1234"), "and a timestamp");

  mock.out_len = 0;
  mock.out[0] = '\0';
  fx_core_poll();
  check(mock.out_len == 0, "an idle poll says nothing");
}

static void test_i2c(void) {
  if (fx_i2c_count == 0) return;
  begin("i2c");
  const fx_i2c_desc* b = &fx_i2c[0];
  bool guarded = b->guard >= 0 && !fx_gpio[b->guard].initial_asserted;
  char req[512];

  mock.i2c_present[b->index][0x50] = true;
  mock.i2c_reply = 0xA5;

  snprintf(req, sizeof(req),
           "{\"jsonrpc\":\"2.0\",\"id\":1,\"method\":\"i2c.scan\",\"params\":{\"channel\":\"%s\"}}",
           b->name);
  send(req);
  if (guarded) {
    check(last_has("-32003"), "a guarded bus refuses a scan");
    return;
  }
  check(last_has("[80]"), "the scan finds the device that answers");

  snprintf(req, sizeof(req),
           "{\"jsonrpc\":\"2.0\",\"id\":1,\"method\":\"i2c.read\","
           "\"params\":{\"channel\":\"%s\",\"address\":80,\"length\":2}}",
           b->name);
  send(req);
  check(last_has("\"hex\":\"a5a5\""), "reads return the device's bytes");

  snprintf(req, sizeof(req),
           "{\"jsonrpc\":\"2.0\",\"id\":1,\"method\":\"i2c.read\","
           "\"params\":{\"channel\":\"%s\",\"address\":81,\"length\":2}}",
           b->name);
  send(req);
  check(last_has("-32004"), "an address that does not answer is an error, not empty data");

  snprintf(req, sizeof(req),
           "{\"jsonrpc\":\"2.0\",\"id\":1,\"method\":\"i2c.read\","
           "\"params\":{\"channel\":\"%s\",\"address\":200,\"length\":2}}",
           b->name);
  send(req);
  check(last_has("-32602"), "an address outside 7 bits is rejected");

  snprintf(req, sizeof(req),
           "{\"jsonrpc\":\"2.0\",\"id\":1,\"method\":\"i2c.write\","
           "\"params\":{\"channel\":\"%s\",\"address\":80,\"hex\":\"0102\"}}",
           b->name);
  send(req);
  check(mock.i2c_last_write_len == 2 && mock.i2c_last_write[1] == 0x02, "writes reach the bus");
}

static void test_spi(void) {
  if (fx_spi_count == 0) return;
  begin("spi");
  const fx_spi_desc* s = &fx_spi[0];
  mock.spi_reply = 0x5A;
  char req[512];
  snprintf(req, sizeof(req),
           "{\"jsonrpc\":\"2.0\",\"id\":1,\"method\":\"spi.transfer\","
           "\"params\":{\"channel\":\"%s\",\"hex\":\"0f0f\"}}",
           s->name);
  send(req);
  if (s->role == FX_ROLE_MONITOR) {
    check(last_has("-32005"), "a monitor bus refuses to drive the lines");
  } else if (s->guard >= 0 && !fx_gpio[s->guard].initial_asserted) {
    check(last_has("-32003"), "a guarded bus refuses to drive until the guard is asserted");
  } else {
    check(last_has("\"hex\":\"5a5a\""), "a transfer returns what came back");
    check(mock.spi_last_tx_len == 2, "and sent what it was given");
  }
}

static void test_guard_interlock(void) {
  /* Find any bus with a guard, assert the guard, and confirm the bus opens up. */
  int8_t guard = -1;
  const char* bus = NULL;
  const char* method = NULL;
  for (size_t i = 0; i < fx_i2c_count && guard < 0; i++)
    if (fx_i2c[i].guard >= 0) {
      guard = fx_i2c[i].guard;
      bus = fx_i2c[i].name;
      method = "i2c.scan";
    }
  for (size_t i = 0; i < fx_uart_count && guard < 0; i++)
    if (fx_uart[i].guard >= 0) {
      guard = fx_uart[i].guard;
      bus = fx_uart[i].name;
      method = "uart.write";
    }
  if (guard < 0) return;

  begin("guard interlock");
  char req[512];
  snprintf(req, sizeof(req),
           "{\"jsonrpc\":\"2.0\",\"id\":1,\"method\":\"gpio.write\","
           "\"params\":{\"channel\":\"%s\",\"assert\":true}}",
           fx_gpio[guard].name);
  send(req);
  check(last_has("\"asserted\":true"), "the guard can be asserted");

  if (strcmp(method, "uart.write") == 0)
    snprintf(req, sizeof(req),
             "{\"jsonrpc\":\"2.0\",\"id\":2,\"method\":\"uart.write\","
             "\"params\":{\"channel\":\"%s\",\"hex\":\"00\"}}",
             bus);
  else
    snprintf(req, sizeof(req),
             "{\"jsonrpc\":\"2.0\",\"id\":2,\"method\":\"i2c.scan\","
             "\"params\":{\"channel\":\"%s\"}}",
             bus);
  send(req);
  check(!last_has("-32003"), "and the guarded bus then accepts traffic");
}

static void test_json_escaping(void) {
  begin("json escaping");
  send("{\"jsonrpc\":\"2.0\",\"id\":\"a\\\"b\",\"method\":\"nope\"}");
  check(last_has("-32601"), "an id containing a quote does not break parsing");
  mock.out_len = 0;
  mock.out[0] = '\0';
  send(
      "{\"jsonrpc\":\"2.0\",\"id\":1,\"method\":\"gpio.read\","
      "\"params\":{\"channel\":\"a\\nb\"}}");
  check(last_has("-32001"), "a control character in a name is handled, not injected");
  size_t newlines = 0;
  for (size_t i = 0; i < mock.out_len; i++)
    if (mock.out[i] == '\n') newlines++;
  check(newlines == 1, "one response is exactly one line, however odd its contents");
}

/* Config-derived expectations, written out by pinside from the fixture config. */
static void test_generated_roster(void) {
  current = "generated roster";
    check(fx_gpio_count == 19, "the config declares 19 gpio channels");
  check(fx_adc_count == 2, "the config declares 2 adc channels");
  check(fx_uart_count == 1, "the config declares 1 uart buses");
  check(fx_i2c_count == 1, "the config declares 1 i2c buses");
  check(fx_spi_count == 1, "the config declares 1 spi buses");
  check(strcmp(fx_gpio[0].name, "tc1_cs") == 0 && fx_gpio[0].pin == 6, "tc1_cs is on GPIO6");
  check(strcmp(fx_gpio[1].name, "tc1_drdy") == 0 && fx_gpio[1].pin == 7, "tc1_drdy is on GPIO7");
  check(strcmp(fx_gpio[2].name, "tc1_fault") == 0 && fx_gpio[2].pin == 8, "tc1_fault is on GPIO8");
  check(strcmp(fx_gpio[3].name, "ssr1") == 0 && fx_gpio[3].pin == 9, "ssr1 is on GPIO9");
  check(strcmp(fx_gpio[4].name, "heat_en") == 0 && fx_gpio[4].pin == 10, "heat_en is on GPIO10");
  check(strcmp(fx_gpio[5].name, "pump_node") == 0 && fx_gpio[5].pin == 11, "pump_node is on GPIO11");
  check(strcmp(fx_gpio[6].name, "heat_en_dc") == 0 && fx_gpio[6].pin == 12, "heat_en_dc is on GPIO12");
  check(strcmp(fx_gpio[7].name, "coil_drv") == 0 && fx_gpio[7].pin == 13, "coil_drv is on GPIO13");
  check(strcmp(fx_gpio[8].name, "alarm") == 0 && fx_gpio[8].pin == 14, "alarm is on GPIO14");
  check(strcmp(fx_gpio[9].name, "enc_a") == 0 && fx_gpio[9].pin == 15, "enc_a is on GPIO15");
  check(strcmp(fx_gpio[10].name, "enc_b") == 0 && fx_gpio[10].pin == 16, "enc_b is on GPIO16");
  check(strcmp(fx_gpio[11].name, "enc_btn") == 0 && fx_gpio[11].pin == 17, "enc_btn is on GPIO17");
  check(strcmp(fx_gpio[12].name, "tc1_p") == 0 && fx_gpio[12].pin == 18, "tc1_p is on GPIO18");
  check(strcmp(fx_gpio[13].name, "tc1_n") == 0 && fx_gpio[13].pin == 19, "tc1_n is on GPIO19");
  check(strcmp(fx_gpio[14].name, "curr_sense") == 0 && fx_gpio[14].pin == 20, "curr_sense is on GPIO20");
  check(strcmp(fx_gpio[15].name, "esp32_en") == 0 && fx_gpio[15].pin == 21, "esp32_en is on GPIO21");
  check(strcmp(fx_gpio[16].name, "esp32_io0") == 0 && fx_gpio[16].pin == 22, "esp32_io0 is on GPIO22");
  check(strcmp(fx_gpio[17].name, "coil_permit") == 0 && fx_gpio[17].pin == 23, "coil_permit is on GPIO23");
  check(strcmp(fx_gpio[18].name, "supervisor_reset") == 0 && fx_gpio[18].pin == 24, "supervisor_reset is on GPIO24");
  check(strcmp(fx_adc[0].name, "ch_5v") == 0 && fx_adc[0].adc == 0, "ch_5v reads ADC0");
  check(strcmp(fx_adc[1].name, "ch_3_3v") == 0 && fx_adc[1].adc == 1, "ch_3_3v reads ADC1");
  check(strcmp(fx_uart[0].name, "supervisor_uart") == 0 && fx_uart[0].index == 0, "supervisor_uart is uart0");
  check(strcmp(fx_i2c[0].name, "i2c_i2c") == 0 && fx_i2c[0].index == 0, "i2c_i2c is i2c0");
  check(strcmp(fx_spi[0].name, "spi_spi") == 0 && fx_spi[0].index == 0, "spi_spi is spi0");
}

int main(void) {
  test_ready_notification();
  test_info();
  test_channels_lists_everything();
  test_protocol_errors();
  test_long_line_is_rejected_and_recovered();
  test_gpio();
  test_adc_scaling();
  test_uart();
  test_uart_streaming();
  test_i2c();
  test_spi();
  test_guard_interlock();
  test_json_escaping();
  test_generated_roster();

  printf("%d checks, %d failures\n", checks, failures);
  return failures == 0 ? 0 : 1;
}
